## examples/esp-idf/dpp-esp32devkitc/components/qp-c/Kconfig
```kconfig
menu "QP/C Real-Time Embedded Framework"
  config QP_ENABLED
    bool "QP/C Real-Time Embedded Framework"
    default y
    help
      Select this option to enable QPC Framework

  menu "QP/C Configuration"
    visible if QP_ENABLED
    choice QPC_PINNED_TO_CORE_CHOICE
      prompt "The cpu core which QPC run"
      depends on !FREERTOS_UNICORE
      default QPC_PINNED_TO_CORE_1
      help
        Specify the cpu core to run QPC.
      config QPC_PINNED_TO_CORE_0
        bool "Core 0 (PRO CPU)"
      config QPC_PINNED_TO_CORE_1
        bool "Core 1 (APP CPU)"
      config QPC_NO_CORE_AFFINITY
        bool "No Affinity (PRO or APP CPU)"
    endchoice #QPC_PINNED_TO_CORE_CHOICE

    menu "Event Memory Pool"
      visible if QP_ENABLED
      config QPC_SMALL_POOL_SIZE
        int "Small Memory Pool Size"
        range 16 512
        default 32
        help
          Max number of events in a small memory pool
      config QPC_MEDIUM_POOL_SIZE
        int "Medium Memory Pool Size"
        range 16 512
        default 32
        help
          Max number of events in a medium memory pool
      config QPC_MEDIUM_POOL_ENTRY_SIZE
        int "Medium Memory Pool Entry Size"
        default 16
      config QPC_LARGE_POOL_SIZE
        int "Large Memory Pool Size"
        range 16 512
        default 32
        help
          Max number of events in a large memory pool
      config QPC_LARGE_POOL_ENTRY_SIZE
        int "Large Memory Pool Entry Size"
        default 32

    endmenu #"Event Memory Pool"

  endmenu #QPC Configuration

  config QPC_QSPY_ENABLE
      bool "Enable QSpy"
      default n

endmenu
```

## zephyr/Kconfig
```kconfig
# QPC Zephyr module
# SPDX-License-Identifier: GPL-3.0-or-later OR LicenseRef-QL-commercial

menuconfig QPC
    bool "QPC"
    default n
    help
        Enables the QPC Module

if QPC

config QSPY
    bool "QSPY Tracing"
    default n
    help
      Enables the QSPY Tracing for QP

module = QPC
module-str = QPC

endif
```
